#include <LCD1602.h>

static void delayUs(uint us);

/*******************************************************************************
* 函 数 名       : lcd1602Init
* 函数功能		 		 : 初始化LCD1602
* 输    入       : 无
* 输    出    	 : 无
*******************************************************************************/
void lcd1602Init()
{
	lcd1602WriteCommand(0x38);  //功能设定指令
	lcd1602WriteCommand(0x0F);  //显示开关控制指令
	//lcd1602WriteCommand(0x06);  //进入模式设置指令
	lcd1602WriteCommand(0x01);  //清屏指令
	delayMs(100);  //等待LCD初始化完成
}

/*******************************************************************************
* 函 数 名       : lcd1602ReadState
* 函数功能		 		 : LCD1602读状态，BF(1bit)和AC(7bit)
* 输    入       : 无
* 输    出    	 : 无
*******************************************************************************/
//读状态 输入：RS=L，RW=H，E=H 输出：DB0～DB7=状态字 
uchar lcd1602ReadState()
{
	uchar lcdState = 0;
	
	lcd1602_RS = 0;
	lcd1602_WR = 1;
	lcd1602_EN = 1;
	lcdState = P0;
	delayUs(2);
	return lcdState;
}

/*******************************************************************************
* 函 数 名       : lcd1602WriteCommand
* 函数功能		 		 : LCD1602写命令
* 输    入       : 无
* 输    出    	 : 无
*******************************************************************************/
//写指令 输入：RS=L，RW=L，E=下降沿脉冲，DB0～DB7=指令码 输出：无 
void lcd1602WriteCommand(uchar cmd)
{
	lcd1602_RS = 0;
	lcd1602_WR = 0;
	lcd1602_EN = 1;
	delayUs(2);
	P0 = cmd;
	lcd1602_EN = 0;
	delayUs(2);
}

/*******************************************************************************
* 函 数 名       : lcd1602WriteData
* 函数功能		 		 : LCD1602写数据
* 输    入       : 无
* 输    出    	 : 无
*******************************************************************************/
//写数据 输入：RS=H，RW=L，E=下降沿脉冲，DB0～DB7=数据  输出：无
void lcd1602WriteData(uchar dat)
{
	lcd1602_RS = 1;
	lcd1602_WR = 0;
	lcd1602_EN = 1;
	delayUs(2);
	P0 = dat;
	lcd1602_EN = 0;
	delayUs(2);
}

/*******************************************************************************
* 函 数 名       : lcd1602ReadData
* 函数功能		 		 : LCD1602读数据
* 输    入       : 无
* 输    出    	 : 无
*******************************************************************************/
//读数据 输入：RS=H，RW=H，E=H  输出：DB0～DB7=数据 
uchar lcd1602ReadData()
{
	uchar lcdReadData = 0;
	lcd1602_RS = 1;
	lcd1602_WR = 1;
	lcd1602_EN = 1;
	lcdReadData = P0;
	delayUs(2);
	return lcdReadData;
}

/*******************************************************************************
* 函 数 名       : lcdDisplayChar
* 函数功能		 		 : LCD1602显示字符
* 输    入       : x:列
									y:行
									dat:显示的字符
* 输    出    	 : 无
*******************************************************************************/
void lcdDisplayChar(unsigned char x, unsigned char y, unsigned char dat)
{
	if(y == 1)
		lcd1602WriteCommand(0x80 + (x-1));
	else
		lcd1602WriteCommand(0xC0 + (x-1));
	
	lcd1602WriteData(dat);
}

/*******************************************************************************
* 函 数 名       : lcdDisplatString
* 函数功能		 		 : LCD1602显示字符串
* 输    入       : x:列
									y:行
									str:显示的字符串
* 输    出    	 : 无
*******************************************************************************/
void lcdDisplatString(unsigned char x, unsigned char y, char *str)
{
	unsigned char address = 0;
	if(y == 1)
		address = 0x80 + (x-1);
	else
		address = 0xC0 + (x-1);
	
	while(*str != '\0')
	{
		lcd1602WriteCommand(address);
		lcd1602WriteData(*str);
		str++;
		address++;
		if(((address & 0x7F) > 0x0F) && (((address & 0x7F) < 0x27)))
		{
			address = 0xC0;
		}
		else if(((address & 0x7F) > 0x4F) && ((address & 0x7F) < 0x67))
		{
			address = 0x80;
		}
	}
}

/*******************************************************************************
* 函 数 名       : lcd1602Clear
* 函数功能		 		 : 清屏
* 输    入       : 无
* 输    出    	 : 无
*******************************************************************************/
void lcd1602Clear()
{
	lcd1602WriteCommand(0x01);
}

/*******************************************************************************
* 函 数 名       : delayMs
* 函数功能		 		 : 延时函数，ms = 1，延时1ms
* 输    入       : ms:延时时间
* 输    出    	 : 无
*******************************************************************************/
void delayMs(unsigned int ms)
{
	int i = 0;
	int j = 0;
	for(i = 0;i < ms;i++)
	{
		for(j = 0;j < 130;j++);
	}
}

/*******************************************************************************
* 函 数 名       : delayUs
* 函数功能		 		 : 延时函数，us = 1，延时3us
* 输    入       : us:延时时间
* 输    出    	 : 无
*******************************************************************************/
static void delayUs(uint us)
{
	while(us--);
}
